## arch/mips/mach-trivialmips/Kconfig
```kconfig
menu "TrivialMIPS platforms"
    depends on MACH_TRIVIALMIPS

choice
    prompt "Board select"

config TARGET_TRIVIALMIPS_THINPAD
    bool "Thinpad board 2017"

config TARGET_TRIVIALMIPS_NSCSCC
    bool "NSCSCC board 2019"

endchoice

source "board/thucst/Kconfig"

source "board/nscscc/Kconfig"

endmenu
```

## board/nscscc/Kconfig
```kconfig
if TARGET_TRIVIALMIPS_NSCSCC

config SYS_BOARD
    default "2019"

config SYS_VENDOR
    default "nscscc"

config SYS_CONFIG_NAME
    default "trivialmips_nscscc"

config SYS_TEXT_BASE
    default 0x80000000

endif
```

## board/thucst/Kconfig
```kconfig
if TARGET_TRIVIALMIPS_THINPAD

config SYS_BOARD
    default "thinpad"

config SYS_VENDOR
    default "thucst"

config SYS_CONFIG_NAME
    default "trivialmips_thinpad"

config SYS_TEXT_BASE
    default 0x80000000

endif
```
